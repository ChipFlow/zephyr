## boards/chipflow/chipflow_minerva/board.yml
```yaml
board:
  name: chipflow_minerva
  vendor: chipflow
  socs:
  - name: chipflow_minerva
```

## boards/chipflow/chipflow_minerva/chipflow_minerva_defconfig
```kconfig
CONFIG_SYS_CLOCK_HW_CYCLES_PER_SEC=48000000
CONFIG_SYS_CLOCK_TICKS_PER_SEC=48000000
CONFIG_SERIAL=y
CONFIG_UART_CHIPFLOW=y
CONFIG_UART_CONSOLE=y
CONFIG_CONSOLE=y
```

## drivers/serial/Kconfig.chipflow
```kconfig
config UART_CHIPFLOW
	bool "ChipFlow serial driver"
	default y
	depends on DT_HAS_CHIPFLOW_UART_ENABLED
	select SERIAL_HAS_DRIVER
	help
	  This option enables ChipFlow UART serial driver.
```

## dts/bindings/serial/chipflow,uart.yaml
```yaml
description: ChipFlow UART

compatible: "chipflow,uart"

include: [uart-controller.yaml]

properties:
  reg:
    required: true
```

## dts/bindings/timer/chipflow,machine-timer.yaml
```yaml
description: |
  ChipFlow Machine Timer

compatible: "chipflow,machine-timer"

include: base.yaml

properties:
  reg:
    required: true

  interrupts:
    required: true
```

## soc/chipflow/chipflow_minerva/Kconfig
```kconfig
config SOC_CHIPFLOW_MINERVA
	bool

	select RISCV
	select RISCV_PRIVILEGED

	select RISCV_ISA_RV32I
	select RISCV_ISA_EXT_M
	select RISCV_ISA_EXT_ZICSR
	select RISCV_ISA_EXT_ZIFENCEI

	select ATOMIC_OPERATIONS_C
	select INCLUDE_RESET_VECTOR
	imply XIP
```

## soc/chipflow/chipflow_minerva/Kconfig.soc
```kconfig
config SOC_CHIPFLOW_MINERVA
	bool

config SOC
	default "chipflow_minerva" if SOC_CHIPFLOW_MINERVA
```
